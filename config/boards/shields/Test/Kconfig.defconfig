## config/boards/shields/Test/Kconfig.defconfig
```kconfig
if SHIELD_ROBA_R

config ZMK_KEYBOARD_NAME
    default "roBa_R"

//CONFIG_ZMK_BLE
//    default y

config ZMK_SPLIT
    default y


 config ZMK_SPLIT_ROLE_CENTRAL
    default y

endif

if SHIELD_ROBA_L

 config ZMK_KEYBOARD_NAME
    default "roBa_L"

//CONFIG_ZMK_BLE
//    default y

config ZMK_SPLIT
    default y

endif
```
